## boards/arm/controller_f103rb/Kconfig.board
```kconfig
# controller_f103rb board
#
# Copyright (c) 2021 Marek Metelski
# SPDX-License-Identifier: Apache-2.0

config BOARD_CONTROLLER_F103RB
	bool "Flight controller based on f103rb microcontroller"
	depends on SOC_STM32F103XB
```

## boards/arm/controller_f103rb/Kconfig.defconfig
```kconfig
# controller_f103rb configuration
#
# Copyright (c) 2021 Marek Metelski
# SPDX-License-Identifier: Apache-2.0

if BOARD_CONTROLLER_F103RB

config BOARD
	default "controller_f103rb"

endif # BOARD_CONTROLLER_F103RB
```

## boards/arm/controller_f103rb/controller_f103rb_defconfig
```kconfig
CONFIG_SOC_SERIES_STM32F1X=y
CONFIG_SOC_STM32F103XB=y

CONFIG_PINMUX=y

# peripherals
CONFIG_GPIO=y
CONFIG_SERIAL=y
CONFIG_ADC=y
CONFIG_I2C=y
CONFIG_SENSOR=y
CONFIG_MPU6050=y


CONFIG_CLOCK_CONTROL=y
```

## boards/arm/controller_l071rb/Kconfig.board
```kconfig
# controller_f072rb board
#
# Copyright (c) 2021 Marek Metelski
# SPDX-License-Identifier: Apache-2.0

config BOARD_CONTROLLER_L071RB
	bool "Flight controller based on f103rb microcontroller"
	depends on SOC_STM32L071XB
```

## boards/arm/controller_l071rb/Kconfig.defconfig
```kconfig
# controller_l071rb configuration
#
# Copyright (c) 2021 Marek Metelski
# SPDX-License-Identifier: Apache-2.0

if BOARD_CONTROLLER_L071RB

config BOARD
	default "controller_l071rb"

endif # BOARD_CONTROLLER_L071RB
```

## boards/arm/controller_l071rb/controller_l071rb_defconfig
```kconfig
CONFIG_SOC_SERIES_STM32L0X=y
CONFIG_SOC_STM32L071XX=y

CONFIG_ARM_MPU=y
CONFIG_PINMUX=y

# peripherals
CONFIG_GPIO=y
CONFIG_SERIAL=y
CONFIG_ADC=y
CONFIG_I2C=y
CONFIG_SENSOR=y
CONFIG_MPU6050=y


CONFIG_CLOCK_CONTROL=y
```

## drivers/bcm/Kconfig
```kconfig
menuconfig BCM
       bool "enable BCM drivers"
if BCM

module = BCM
module-str = bcm
source "subsys/logging/Kconfig.template.log_config"

rsource "Kconfig.sys"

endif # BCM
```

## drivers/bcm/Kconfig.sys
```kconfig
config BCM_SYS
       bool "BCM driver based on system timers"
       help
         "Enable BCM driver utilizing kernel system timers"
```

## drivers/motors/Kconfig
```kconfig
menuconfig MOTORS
       bool "enable motors"

if MOTORS

module = MOTORS
module-str = motors
source "subsys/logging/Kconfig.template.log_config"

endif #MOTORS
```

## modules/Kconfig.cmsis_dsp
```kconfig
config CMSIS_DSP_QUATERNIONMATH
       bool "Quaternion Math Functions"
       help
         This option enables Quaternion Math Functions.
         This is for custom cmsis module created from
         CMSIS_5 develop branch with quaternion math support.
         see: https://github.com/MaroMetelski/cmsis
```
